## app/boards/my_board/Kconfig
```kconfig
config HEAP_MEM_POOL_ADD_SIZE_BOARD
	int
	default 4096 if BOARD_MY_BOARD_PROCPU
	default 256 if BOARD_MY_BOARD_APPCPU
```

## app/boards/my_board/Kconfig.my_board
```kconfig
config BOARD_MY_BOARD
	select SOC_ESP32S3_WROOM_N8
	select SOC_ESP32S3_PROCPU if BOARD_MY_BOARD_ESP32S3_PROCPU
	select SOC_ESP32S3_APPCPU if BOARD_MY_BOARD_ESP32S3_APPCPU
```

## app/boards/my_board/board.yml
```yaml
board:
  name: my_board
  full_name: my_board from scratch
  vendor: iomico
  socs:
  - name: esp32s3
```

## app/boards/our_board/board.yml
```yaml
board:
  name: our_board
  full_name: our_board
  vendor: iomico
  socs:
  - name: esp32s3
```
